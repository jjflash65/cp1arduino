/* ---------------------------------------------------------------------------
                               st7735.cpp

     Funktionen fuer TFT-Display mit ST7735 Grafikcontrollerchip

     20.03.2021    R. Seelig
   --------------------------------------------------------------------------- */
   
#include "st7735.h"
   
extern const uint8_t font5x7 [][5];
extern const uint8_t font8x8[][8];
extern const uint8_t font12x16[][32];


#define delay_flag 0x80                               // Markierungsflag: bestimmt, ob nach einem Kommando

static const uint8_t PROGMEM lcdinit_seq[] =            // Initialisierungssequenzen
{
    21,                                                 // Anzahl Gesamtkommandos

    0x01, delay_flag,150,
    0x11, delay_flag,255,
    0xb1, 3, 0x01, 0x2C, 0x2D,
    0xb2, 3, 0x01, 0x2C, 0x2D,
    0xb3, 6, 0x01, 0x2C, 0x2D, 0x01, 0x2C, 0x2D,
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      0x36, 1, 0xc0,                                      // 00 fuer auf dem Kopf stehend
                                                          // C0 fuer Normal, BGR Farbfolge
                                                          // C8 fuer Normal, RGB Farbfolge
    0x3a, 1+delay_flag, 0x05,10,

    0x2a, 4, 0x00, 0x00, 0x00, 0x7F,
    0x2b, 4, 0x00, 0x00, 0x00, 0x9F,

    0xe0, 16, 0x02, 0x1c, 0x07, 0x12, 0x37, 0x32, 0x29, 0x2d,
              0x29, 0x25, 0x2B, 0x39, 0x00, 0x01, 0x03, 0x10,
    0xe1, 16, 0x03, 0x1d, 0x07, 0x06, 0x2E, 0x2C, 0x29, 0x2D,
              0x2E, 0x2E, 0x37, 0x3F, 0x00, 0x00, 0x02, 0x10,
    0x13, delay_flag,10,
    0x29, delay_flag,100,
};
 
// RGB565 Farbpallete der "EGA"-Farben
uint16_t egapalette [] =
    { 0x0000, 0x0015, 0x0540, 0x0555,
      0xa800, 0xa815, 0xaaa0, 0xad55,
      0x52aa, 0x52bf, 0x57ea, 0x57ff,
      0xfaaa, 0xfabf, 0xffea, 0xffff };

  uint8_t tft_rstpin;
  uint8_t tft_dcpin;
  uint8_t tft_cepin;
  uint8_t _colfolge;      
    
  #define spi_ddr                 DDRB
  #define spi_mosi_pin            PB3          //     11                  17
  #define spi_clk_pin             PB5          //     13                  19
  #define spi_ss_pin              PB2          //     10                  16    

  #define rst_set()               digitalWrite(tft_rstpin, HIGH)
  #define rst_clr()               digitalWrite(tft_rstpin, LOW)
  #define lcd_rst_init()          pinMode(tft_rstpin, OUTPUT)

  #define dc_set()                digitalWrite(tft_dcpin, HIGH)
  #define dc_clr()                digitalWrite(tft_dcpin, LOW)
  #define lcd_dc_init()           pinMode(tft_dcpin, OUTPUT)

  #define ce_set()                digitalWrite(tft_cepin, HIGH)
  #define ce_clr()                digitalWrite(tft_cepin, LOW)
  #define lcd_ce_init()           pinMode(tft_cepin, OUTPUT)
  
  #define lcd_pin_init()          { lcd_rst_init(); lcd_dc_init(); lcd_ce_init(); }
  #define lcd_enable()            ( ce_clr() )
  #define lcd_disable()           ( ce_set() )        

/* -------------------------------------------------------
                       st7735::st7735
                         Konstruktor

     setzt die Pins fuer RST, CE und DC sowie die
     Farbfolge (_RGB oder _BGR)
   ------------------------------------------------------- */
st7735::st7735(uint8_t rst, uint8_t dc, uint8_t ce)
{
  tft_rstpin= rst; tft_dcpin= dc; tft_cepin= ce;
}

/* -------------------------------------------------------
                       st7735::version_g

     Displays mit 128x128 Pixel in der zweiten Generation
     haben einen Offset des Displayrams, der mit dieser
     Methode behoben werden kann
   ------------------------------------------------------- */
void st7735::version_g()
{
  colofs= 2; rowofs= 3;  
}

/* -------------------------------------------------------
                       st7735::ofsmode

     Manche Displays haben einen Fehler bezueglich der
     Adressierung im Bildspeicher, hier kann explizit
     festgelegt werden, ab welcher Reihe die Darstellung
     erfolgt.
   ------------------------------------------------------- */
void st7735::ofsmode(int8_t ofs)
{
  _lcyofs= ofs;
}

/* ----------------------------------------------------------
     st7735:spi_init

     initialisiert die SPI Hardware des AVR Controllers
   ---------------------------------------------------------- */ 
void st7735::spi_init()
{
  spi_ddr |= (1 << spi_mosi_pin) | (1 << spi_clk_pin) | (1 << spi_ss_pin);
    
  // Enable SPI Port: Keine Interrupts, MSB first, Master Modus
  SPCR = (1 << SPE) | (1 << MSTR);
  // Taktrate F_CPU/2
  SPSR = (1 << SPI2X);
}


/* -------------------------------------------------------------
     st7735::spi_lcdout

      Byte ueber SPI senden

        data : zu sendendes Datum
   ------------------------------------------------------------- */
void st7735::spi_lcdout(uint8_t data)
{
  uint8_t dummy;

  SPDR=data;                                // Datum senden
  while( ( SPSR & 0x80 ) != 0x80 );         // ... und warten bis es gesendet ist

  dummy= SPDR;
}

/* -------------------------------------------------------------
     st7735::wrcmd

     sendet Kommando via SPI an das LCD

      data : zu sendendes Datum
   ------------------------------------------------------------- */
void st7735::wrcmd(uint8_t cmd)
{
  dc_clr();                             // C/D = 0 Kommandomodus
  spi_lcdout(cmd);                         // senden
}

/* -------------------------------------------------------------
     st7735::wrdata

     sendet Datum via SPI an das LCD

       data : zu sendendes Datum
   ------------------------------------------------------------- */
void st7735::wrdata(uint8_t data)
{
  dc_set();                             // C/D = 1 Kommandomodus
  spi_lcdout(data);                        // senden/
}

/* ----------------------------------------------------------
     st7735::wrdata16

     sendet ein 16 Bit Integer via SPI an das Display

       data : zu sendendes 16-Bit Datum

   ---------------------------------------------------------- */

void st7735::wrdata16(int data)
{
    int data1 = data >> 8;
    int data2 = data & 0xff;

    dc_set();
    spi_lcdout(data1);
    spi_lcdout(data2);
}
    
/* ----------------------------------------------------------
     st7735::set_ram_address

     legt den Zeichenbereich des Displays fest
   ---------------------------------------------------------- */
void st7735::set_ram_address (uint16_t x1, uint16_t y1, uint16_t x2, uint16_t y2)
{
  wrcmd(coladdr);
  wrdata((x1) >> 8);
  wrdata(x1 + colofs);
  wrdata((x2) >> 8);
  wrdata(x2 + colofs);

  wrcmd(rowaddr);
  if (_yres == 128)
  {
     wrdata(0x00 + rowofs);
     wrdata(y1+32+_lcyofs + rowofs);
     y2 += 32;					// Dummy um Warning85 zu verhindern
  }    
  else
  {
    wrdata((y1 >> 8) + rowofs);
    wrdata(y1);
    wrdata((y2 >> 8) + rowofs);
    wrdata(y2);
  }

  wrcmd(writereg);
}

/* ----------------------------------------------------------
     st7735::clrscr

     loescht den Displayinhalt mit der in der Variable
     "bkcolor" angegebenen Farbe
   ---------------------------------------------------------- */

void st7735::clrscr()
{
  int      x,y;
  uint8_t  colouthi, coloutlo;

  set_ram_address(0,0,_xres-1,_yres-1);

  colouthi = bkcolor >> 8;
  coloutlo = bkcolor & 0xff;

  dc_set();

  for (y= 0; y< _yres; y++)
  {
    for (x= 0; x< _xres; x++)
    {
      wrdata(colouthi);
      wrdata(coloutlo);
    }
  }

}

/* ----------------------------------------------------------
     st7735::setcol

     schreibt einen Farbpunkt ins Display-Ram

       coladdr  : Adresse im Display-Ram
   ---------------------------------------------------------- */
void st7735::setcol(int startcol)
{
    wrcmd(coladdr);
    wrdata16(startcol + colofs);
}

/* ----------------------------------------------------------
     st7735::setpage
   ---------------------------------------------------------- */
void st7735::setpage(int startpage)
{
    wrcmd(rowaddr);
    wrdata16(startpage + rowofs);
}

/* ----------------------------------------------------------
     st7735::setxypos

     waehlt die Position im Display-Ram aus, auf die der
     naechste Datentransfer erfolgen wird

       x,y : fuer diese Koordinaten wird die Speicheradresse
             im Display-Ram berechnet
   ---------------------------------------------------------- */
void st7735::setxypos(int x, int y)
{
      if (_mirror == 1)
      {
        setcol(_xres-x);
      }
      else
      {
        setcol(x);
      }

      if ( _yres == 128 )
      {
        setpage(y+32+_lcyofs);
      }  
      else
      {
        setpage(y);
      }

    wrcmd(writereg);
}

/* ----------------------------------------------------------
     st7735::putpixel

     zeichnet einen einzelnen Punkt auf dem Display an der
     Koordinate x,y mit der Farbe color.

     Putpixel beruecksichtigt die globale Variable "outmode"
     mithilfe derer es moeglich ist, eine Ausgabe auf dem
     Display zu "drehen"

       x,y   : Koordinaten, an die ein Farbpixel gezeichnet
               wird
       color : RGB565 Farbwert, der gezeichnet wird
   ---------------------------------------------------------- */
void st7735::putpixel(int x, int y,uint16_t color)
{
  switch (outmode)
  {
    case 0  :  setxypos(x,y); break;
    case 1  :  setxypos(y,_yres-1-x); break;
    case 2  :  setxypos(_xres-1-y,x); break;
    case 3  :  setxypos(_xres-1-x, _yres-1-y); break;
  
    default : break;
  
  }
  
  wrdata16(color);
}

/* -------------------------------------------------------------
     st7735::putpixeltx

     Pixelausgabe, von den putchar Funktionen benutzt, damit
     fuer outtextxy die Ausgaberichtung vorgegeben werden
     kann

        x,y   : Koordinaten an der der Punkt gezeichnet
                werden soll
        color : 16 - Bit RGB565 Farbwert der gezeichnet
                werden soll
   ------------------------------------------------------------- */
void st7735::putpixeltx(int x, int y, uint16_t color)
{
  if (txoutmode) putpixel(_xres-1-y,x,color); else putpixel(x,y,color);
}

/* --------------------------------------------------
     outtextxy

     Ausgabe eines Textes an den GRAFIK-Koordinaten
     x,y. Der Text wird hierbei ueber den Hintergrund
     gelegt.

       x,y      :  Grafikkoordinaten, ab der der
                   Text ausgegeben wird (linke,
                   obere Ecke)
       dir      : Ausgaberichtung
                    0 = horizontal
                    1 = vertikal
       *p       :  Zeiger auf den Text

   -------------------------------------------------- */
void st7735::outtextxy(int x, int y, char *p)
{
  uint8_t oldfill, oldx, oldy;

  unsigned char c;
  int tmp;

  oldfill= fntfilled;
  fntfilled= 0;
  oldx= aktxp; oldy= aktyp;

  aktxp= x; aktyp= y;
  for (c= *p; c; ++p, c= *p)
  {
    lcd_putchar(c);
  }
  fntfilled= oldfill; aktxp= oldx; aktyp= oldy;
  txoutmode= 0;
}


/* -------------------------------------------------------------
    st7735::init

    initialisiert das Display
   ------------------------------------------------------------- */
void st7735::init(uint16_t xres, uint16_t yres, uint8_t mirror, uint8_t colfolge)
{
  volatile uint8_t  cmd_anz;
  volatile uint8_t  arg_anz;
  volatile uint16_t ms;
  uint16_t i;
  uint8_t ind, dat;

  const uint8_t *tabseq;

  _xres= xres; _yres= yres; _mirror= mirror;

  spi_init();
  lcd_pin_init();

  rst_clr();                            // Resets LCD controler
  delay(2);
  rst_set();


  tabseq= &lcdinit_seq[0];

  // ein einzelnes Kommando besteht aus mehreren Datenbytes. Zuerst wird ein Kommandobyte
  // auf dem SPI geschickt, anschliessend die zu diesem Kommandobytes dazugehoerigen Datenbytes
  // abschliessend wird evtl. ein Timingwait eingefuegt. Dieses wird fuer alle vorhandenen
  // Kommandos durchgefuehrt

  cmd_anz = pgm_read_byte(tabseq++);               // Anzahl Gesamtkommandos
  ind= 1;

  while(cmd_anz--)                                 // alle Kommandos auf SPI schicken
  {
    wrcmd(pgm_read_byte(tabseq++));                // Kommando lesen
    arg_anz= pgm_read_byte(tabseq++);              // Anzahl zugehoeriger Datenbytes lesen
    ind += 2;
    ms= arg_anz & delay_flag;                      // bei gesetztem Flag folgt ein Timingbyte
    arg_anz &= ~delay_flag;                        // delay_flag aus Anzahl Argumenten loeschen
    while(arg_anz--)                               // jedes Datenbyte des Kommandos
    {
      if (
      dat= pgm_read_byte(tabseq++));                   
      if (ind== 55)                                // Indexposition im Initialisierungsarray, an der die
                                                   // Farbfolge RGB oder BGR bestimmt wird
      {
        if (colfolge== _RGB) dat= 0xc8; else dat= 0xc0;   // 0xc8 fuer RGB, 0xc0 fuer BGR
      } 
      wrdata(dat);                                       
      ind++;  
    }
    if(ms)                                         // wenn eine Timingangabe vorhanden ist
    {
      ms= pgm_read_byte(tabseq++);                 // Timingzeit lesen
      ind++;
      if(ms == 255) ms = 500;
      for (i= 0; i< ms; i++) delay(1);             // und entsprechend "nichts" tun
    }
  }
  ce_clr();
  bkcolor= 0;
  clrscr();
}

/* --------------------------------------------------
     st7735::gotoxy

     Setzt den Textcursor (NICHT Pixelkoordinate) an
     die angegebene Textkoordinate.

     Parameter:
        x = X-Koordinate
        y = Y-Koordinate
   -------------------------------------------------- */
void st7735::gotoxy(unsigned char x, unsigned char y)
{
  aktxp= x*(fontsizex+(textsize*fontsizex));
  aktyp= y*(fontsizey+(textsize*fontsizey));
}

/* --------------------------------------------------
     lcd_putchar5x7

     gibt das in ch angegebene Zeichen auf dem
     Display mit einem 5x7 grossen Font aus

     Parameter:
        ch :    auszugebendes Zeichen
   -------------------------------------------------- */
void st7735::putchar5x7(unsigned char ch)
{
  uint8_t x,y,v;

  if (ch== 13)                                          // Fuer <printf> "/r" Implementation
  {
    aktxp= 0;
    return;
  }
  if (ch== 10)                                          // fuer <printf> "/n" Implementation
  {
    aktyp= aktyp+fontsizey+(fontsizey*textsize);
    return;
  }

  for (x= 0; x< 5; x++)
  {
    v= pgm_read_byte(&(font5x7[(ch-32)][x]));
    for (y= 0; y< 7; y++)
    {
      if (v & (1 << y)) 
      {
        putpixeltx(aktxp+x, aktyp+y-1, textcolor);
      }
      else
      {
        if (fntfilled)
        {
          putpixeltx(aktxp+x, aktyp+y-1, bkcolor);
        }        
      }  
    }
  }
  aktxp= aktxp+fontsizex+1;
}

/* --------------------------------------------------
     st7735::lcd_putchar8x8

     gibt das in ch angegebene Zeichen auf dem
     Display mit einem 8x8 grossen Font aus

     Parameter:
        ch :    auszugebendes Zeichen
   -------------------------------------------------- */
void st7735::putchar8x8(unsigned char ch)
{
  uint8_t   i,i2;
  uint8_t   b;
  int       oldx,oldy;
  uint16_t  fontint;
  uint16_t  fmask;

  if (ch== 13)                                          // Fuer <printf> "/r" Implementation
  {
    aktxp= 0;
    return;
  }
  if (ch== 10)                                          // fuer <printf> "/n" Implementation
  {
    aktyp= aktyp+fontsizey+(fontsizey*textsize);
    return;
  }

  fmask= 1<<(fontsizex-1);

  oldx= aktxp;
  oldy= aktyp;
  for (i=0; i<fontsizey; i++)
  {
    b= pgm_read_byte(&(font8x8[(ch-32)][i]));
    fontint= b;

    for (i2= 0; i2<fontsizex; i2++)
    {
      if (fmask & fontint)
      {
        putpixeltx(oldx,oldy,textcolor);
        if ((textsize==1))
        {
          putpixeltx(oldx+1,oldy,textcolor);
          putpixeltx(oldx,oldy+1,textcolor);
          putpixeltx(oldx+1,oldy+1,textcolor);
        }
      }
      else
      {
        if (fntfilled)
        {
          putpixeltx(oldx,oldy,bkcolor);
          if ((textsize==1))
          {
            putpixeltx(oldx+1,oldy,bkcolor);
            putpixeltx(oldx,oldy+1,bkcolor);
            putpixeltx(oldx+1,oldy+1,bkcolor);
          }
        }
      }
      fontint= fontint<<1;
      oldx= oldx+1+textsize;
    }
    oldy++;
    if ((textsize==1)) {oldy++; }
    oldx= aktxp;
  }
  aktxp= aktxp+fontsizex+(fontsizex*textsize);
}

/* --------------------------------------------------
     st7735::putchar12x16

     gibt das in ch angegebene Zeichen auf dem
     Display mit einem 12x16 grossen Font aus

     Parameter:
       ch       : auszugebendes Zeichen
   -------------------------------------------------- */
void st7735::putchar12x16(unsigned char ch)
{
  uint8_t   i,i2;
  uint16_t  b;
  int       oldx,oldy;
  uint16_t  fontint;
  uint16_t  fmask;
  uint16_t  findex;

  if (ch== 13)                                          // Fuer <printf> "/r" Implementation
  {
    aktxp= 0;
    return;
  }
  if (ch== 10)                                          // fuer <printf> "/n" Implementation
  {
    aktyp= aktyp+16+(16*textsize);
    return;
  }

  fmask= 1<<(16-1);
  oldx= aktxp;
  oldy= aktyp;
  for (i=0; i<16; i++)
  {
    findex= (ch-32);

    b= pgm_read_byte(&(font12x16[findex][i*2])) << 4;
    b|= pgm_read_byte(&(font12x16[findex][(i*2)+1])) << 12;

    fontint= b;

    for (i2= 0; i2<12; i2++)
    {
      if (fmask & fontint)
      {
        putpixeltx(oldx,oldy,textcolor);
        if ((textsize==1))
        {
          putpixeltx(oldx+1,oldy,textcolor);
          putpixeltx(oldx,oldy+1,textcolor);
          putpixeltx(oldx+1,oldy+1,textcolor);
        }
      }
      else
      {
        if (fntfilled)
        {
          putpixeltx(oldx,oldy,bkcolor);
          if ((textsize==1))
          {
            putpixeltx(oldx+1,oldy,bkcolor);
            putpixeltx(oldx,oldy+1,bkcolor);
            putpixeltx(oldx+1,oldy+1,bkcolor);
          }
        }
      }
      fontint= fontint<<1;
      oldx= oldx+1+textsize;
    }
    oldy++;
    if ((textsize==1)) {oldy++; }
    oldx= aktxp;
  }
  if (textsize==1) aktxp= aktxp + 24; else aktxp = aktxp +12;
}

/* --------------------------------------------------
     st7735::lcd_putchar

     gibt ein Zeichen auf dem Display aus

     Parameter:
       ch   : auszugebendes Zeichen
   -------------------------------------------------- */
void st7735::lcd_putchar(char ch)
{
  switch (fontnr)
  {
    case 0:  putchar8x8(ch); break;
    case 1:  putchar12x16(ch); break;
    case 2:  putchar5x7(ch); break;
    default: break;
  }
}

/* --------------------------------------------------
     st7735::setfont

     legt den Schriftstil fest, der bei einer
     Zeichenausgabe verwendet werden soll

        nr   : Schriftstil
                 0 : 8x8 Font
                 1 : 12x16 Font
                 2 : 5x7 Font
   -------------------------------------------------- */
void st7735::setfont(uint8_t nr)
{
  switch(nr)
  {
    case 0:
    {
      fontsizex= 8;
      fontsizey= 8;
      fontnr= 0;
      break;
    }
    case 1:
    {
      fontsizex= 12;
      fontsizey= 16;
      fontnr= 1;
      break;
    }
    case 2:
    {
      fontsizex= 5;
      fontsizey= 7;
      fontnr= 2;
      break;
    }
    default:
    {
      break;
    }
  }
}

/* -------------------------------------------------------------
     st7735::line

     Zeichnet eine Linie von den Koordinaten x0,y0 zu x1,y1
     mit der angegebenen Farbe

        x0,y0 : Koordinate linke obere Ecke
        x1,y1 : Koordinate rechte untere Ecke
        color : 16 - Bit RGB565 Farbwert der gezeichnet
                werden soll
     Linienalgorithmus nach Bresenham (www.wikipedia.org)

   ------------------------------------------------------------- */
void st7735::line(int x0, int y0, int x1, int y1, uint16_t color)
{

  //    Linienalgorithmus nach Bresenham (www.wikipedia.org)

  int dx =  abs(x1-x0), sx = x0<x1 ? 1 : -1;
  int dy = -abs(y1-y0), sy = y0<y1 ? 1 : -1;
  int err = dx+dy, e2;                                     /* error value e_xy */

  for(;;)
  {

    putpixel(x0,y0,color);
    if (x0==x1 && y0==y1) break;
    e2 = 2*err;
    if (e2 > dy) { err += dy; x0 += sx; }                  /* e_xy+e_x > 0 */
    if (e2 < dx) { err += dx; y0 += sy; }                  /* e_xy+e_y < 0 */
  }
}

/* ----------------------------------------------------------
     st7735::fastxline

     zeichnet eine Linie in X-Achse mit den X Punkten
     x1 und x2 auf der Y-Achse y1

        x1, x2 : Start-, Endpunkt der Linie
        y1     : Y-Koordinate der Linie
        color  : 16 - Bit RGB565 Farbwert der gezeichnet
                 werden soll
   ---------------------------------------------------------- */
void st7735::fastxline(uint8_t x1, uint8_t y1, uint8_t x2, uint16_t color)
{
  uint8_t x;

  if (x2< x1) { x= x1; x1= x2; x= x2= x; }

  for (x= x1; x< (x2+1); x++)
  {
    putpixel(x,y1, color);
  }

}

/* ----------------------------------------------------------
     st7735::fillcret

     zeichnet ein ausgefuelltes Rechteck mit den
     Koordinatenpaaren x1/y1 (linke obere Ecke) und
     x2/y2 (rechte untere Ecke)

        x0,y0 : Koordinate linke obere Ecke
        x1,y1 : Koordinate rechte untere Ecke
        color : Zeichenfarbe
   ---------------------------------------------------------- */
void st7735::fillrect(int x1, int y1, int x2, int y2, uint16_t color)
{
  int y;

  if (y1> y2)
  {
    y= y1;
    y1= y2;
    y2= y;
  }

  for (y= y1; y< y2+1; y++)
  {
    fastxline(x1,y,x2,color);
  }
}

/* -------------------------------------------------------------
     st7735::rectangle

     Zeichnet ein Rechteck von den Koordinaten x0,y0 zu x1,y1
     mit der angegebenen Farbe

        x0,y0  : Koordinate linke obere Ecke
        x1,y1  : Koordinate rechte untere Ecke
        color  : 16 - Bit RGB565 Farbwert der gezeichnet
                 werden soll
   ------------------------------------------------------------- */
void st7735::rectangle(int x1, int y1, int x2, int y2, uint16_t color)
{
  line(x1,y1,x2,y1, color);
  line(x2,y1,x2,y2, color);
  line(x1,y2,x2,y2, color);
  line(x1,y1,x1,y2, color);
}

/* -------------------------------------------------------------
     st7735::ellipse

     Zeichnet eine Ellipse mit Mittelpunt an der Koordinate
     xm,ym mit den Hoehen- Breitenverhaeltnis a:b
     mit der angegebenen Farbe

        xm,ym  : Koordinate des Mittelpunktes der Ellipse
        a,b    : Hoehen- Breitenverhaeltnis
        color  : 16 - Bit RGB565 Farbwert der gezeichnet
                 werden soll

     Ellipsenalgorithmus nach Bresenham (www.wikipedia.org)
   ------------------------------------------------------------- */
void st7735::ellipse(int xm, int ym, int a, int b, uint16_t color )
{
  // Algorithmus nach Bresenham (www.wikipedia.org)

  int dx = 0, dy = b;                       // im I. Quadranten von links oben nach rechts unten

  long a2 = a*a, b2 = b*b;
  long err = b2-(2*b-1)*a2, e2;             // Fehler im 1. Schritt */

  do
  {
    putpixel(xm+dx, ym+dy,color);            // I.   Quadrant
    putpixel(xm-dx, ym+dy,color);            // II.  Quadrant
    putpixel(xm-dx, ym-dy,color);            // III. Quadrant
    putpixel(xm+dx, ym-dy,color);            // IV.  Quadrant

    e2 = 2*err;
    if (e2 <  (2*dx+1)*b2) { dx++; err += (2*dx+1)*b2; }
    if (e2 > -(2*dy-1)*a2) { dy--; err -= (2*dy-1)*a2; }
  } while (dy >= 0);

  while (dx++ < a)                        // fehlerhafter Abbruch bei flachen Ellipsen (b=1)
  {
    putpixel(xm+dx, ym,color);             // -> Spitze der Ellipse vollenden
    putpixel(xm-dx, ym,color);
  }
}

/* -------------------------------------------------------------
     st7735::circle

     Zeichnet einen Kreis mit Mittelpunt an der Koordinate xm,ym
     und dem Radius r mit der angegebenen Farbe

        x ,y   : Koordinate des Mittelpunktes der Ellipse
        r      : Radius des Kreises
        color  : 16 - Bit RGB565 Farbwert der gezeichnet
                 werden soll
   ------------------------------------------------------------- */
void st7735::circle(int x, int y, int r, uint16_t color )
{
  ellipse(x,y,r,r,color);
}

/* -------------------------------------------------------------
     st7735::fillellipse

     Zeichnet eine ausgefuellte Ellipse mit Mittelpunt an der
     Koordinate xm,ym mit den Hoehen- Breitenverhaeltnis a:b
     mit der angegebenen Farbe

        xm,ym  : Koordinate des Mittelpunktes der Ellipse
        a,b    : Hoehen- Breitenverhaeltnis
        color  : 16 - Bit RGB565 Farbwert der gezeichnet
                 werden soll

   Ellipsenalgorithmus nach Bresenham (www.wikipedia.org)
   ------------------------------------------------------------- */
void st7735::fillellipse(int xm, int ym, int a, int b, uint16_t color )
{
  // Algorithmus nach Bresenham (www.wikipedia.org)

  int dx = 0, dy = b;                       // im I. Quadranten von links oben nach rechts unten
  long a2 = a*a, b2 = b*b;
  long err = b2-(2*b-1)*a2, e2;             // Fehler im 1. Schritt */

  do
  {
    fastxline(xm+dx, ym+dy,xm-dx, color);            // I. und II.   Quadrant
    fastxline(xm-dx, ym-dy,xm+dx, color);            // III. und IV. Quadrant

    e2 = 2*err;
    if (e2 <  (2*dx+1)*b2) { dx++; err += (2*dx+1)*b2; }
    if (e2 > -(2*dy-1)*a2) { dy--; err -= (2*dy-1)*a2; }
  } while (dy >= 0);

  while (dx++ < a)                        // fehlerhafter Abbruch bei flachen Ellipsen (b=1)
  {
    putpixel(xm+dx, ym,color);             // -> Spitze der Ellipse vollenden
    putpixel(xm-dx, ym,color);
  }
}

/* -------------------------------------------------------------
     st7735::fillcircle

     Zeichnet einen ausgefuellten Kreis mit Mittelpunt an der
     Koordinate xm,ym und dem Radius r mit der angegebenen Farbe

        x,y    : Koordinate des Mittelpunktes der Ellipse
        r      : Radius des Kreises
        color  : 16 - Bit RGB565 Farbwert der gezeichnet
                 werden soll
   ------------------------------------------------------------- */
void st7735::fillcircle(int x, int y, int r, uint16_t color )
{
  fillellipse(x,y,r,r,color);
}

/* ----------------------------------------------------------
   rgbfromvalue

     Setzt einen 16-Bitfarbwert aus 3 einzelnen Farbwerten
     fuer (r)ot, (g)ruen und (b)lau zusammen.

       r,g,b  : 8-Bit Farbwerte fuer rot, gruen, blau. Aus
                diesen wird ein 16 Bit (RGB565) Farbwert
                generiert und dieser als Funktionsergebnis
                zurueck geliefert
   ---------------------------------------------------------- */
uint16_t rgbfromvalue(uint8_t r, uint8_t g, uint8_t b)
{
  uint16_t value;

  r= r >> 3;
  g= g >> 2;
  b= b >> 3;
  value= b;
  value |= (g << 5);
  value |= (r << 11);
  return value;
}

/* ----------------------------------------------------------
     rgbfromega

     liefert den 16-Bit Farbwert, der in der Ega-Farbpalette
     definiert ist.

         entry : Indexnummer der Farbe in egapalette
   ---------------------------------------------------------- */

uint16_t rgbfromega(uint8_t entry)
{
  return egapalette[entry];
}

/* --------------------------------------------------------------------------------
                                  Schriftstile
   -------------------------------------------------------------------------------- */

static const uint8_t font8x8[][8] PROGMEM =
{
  {0x00,0x00,0x00,0x00,0x00,0x00,0x00,0x00},       // Ascii 32 = ' '
  {0x18,0x18,0x18,0x18,0x18,0x00,0x18,0x00},       // Ascii 33 = '!'
  {0x6c,0x6c,0x6c,0x00,0x00,0x00,0x00,0x00},       // Ascii 34 = '"'
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  {0x00,0x08,0x0c,0x7e,0x7e,0x0c,0x08,0x00}        // 0x84     Pfeil nach rechts
};

static const uint8_t font5x7 [][5] PROGMEM = 
{
  { 0x00, 0x00, 0x00, 0x00, 0x00 },   // space
  { 0x00, 0x00, 0x2f, 0x00, 0x00 },   // !
  { 0x00, 0x07, 0x00, 0x07, 0x00 },   // "
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  { 0x44, 0x64, 0x54, 0x4C, 0x44 },   // z
  // Zeichen vom Ascii-Satz abweichend
  { 0x3E, 0x7F, 0x7F, 0x3E, 0x00 },   // Zeichen 123 : ausgefuelltes Oval
  { 0x06, 0x09, 0x09, 0x06, 0x00 },   // Zeichen 124 : hochgestelltes kleines o (fuer Gradzeichen);
  { 0x01, 0x01, 0x01, 0x01, 0x01 },   // Zeichen 125 : Strich in der obersten Reihe
  { 0x00, 0x1D, 0x15, 0x17, 0x00 }    // Zeichen 126 : "hoch 2"
};

static const uint8_t font12x16[][32] PROGMEM = 
{
  { 0x00,0x00,0x00,0x00,0x00,0x00,0x00,0x00,0x00,0x00,0x00,0x00,0x00,0x00,0x00,0x00,0x00,0x00,0x00,0x00,0x00,0x00,0x00,0x00,0x00,0x00,0x00,0x00,0x00,0x00,0x00,0x00 },   // 0x20
  { 0x60,0x00,0x60,0x00,0xF0,0x00,0xF0,0x00,0xF0,0x00,0xF0,0x00,0xF0,0x00,0x60,0x00,0x60,0x00,0x60,0x00,0x00,0x00,0x00,0x00,0x60,0x00,0x60,0x00,0x00,0x00,0x00,0x00 },   // 0x21
  { 0x00,0x00,0x00,0x00,0x98,0x01,0x98,0x01,0x98,0x01,0x98,0x01,0x00,0x00,0x00,0x00,0x00,0x00,0x00,0x00,0x00,0x00,0x00,0x00,0x00,0x00,0x00,0x00,0x00,0x00,0x00,0x00 },   // 0x22
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  { 0x00,0x00,0x00,0x00,0x00,0x00,0x00,0x00,0x60,0x00,0xF0,0x00,0x98,0x01,0x0C,0x03,0x06,0x06,0x06,0x06,0xFE,0x07,0xFE,0x07,0x00,0x00,0x00,0x00,0x00,0x00,0x00,0x00 },   // 0x7F
};
